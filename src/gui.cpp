/* Copyright (c) 2020, Peter Barrett
**
** Permission to use, copy, modify, and/or distribute this software for
** any purpose with or without fee is hereby granted, provided that the
** above copyright notice and this permission notice appear in all copies.
**
** THE SOFTWARE IS PROVIDED "AS IS" AND THE AUTHOR DISCLAIMS ALL
** WARRANTIES WITH REGARD TO THIS SOFTWARE INCLUDING ALL IMPLIED
** WARRANTIES OF MERCHANTABILITY AND FITNESS. IN NO EVENT SHALL THE AUTHOR
** BE LIABLE FOR ANY SPECIAL, DIRECT, INDIRECT, OR CONSEQUENTIAL DAMAGES
** OR ANY DAMAGES WHATSOEVER RESULTING FROM LOSS OF USE, DATA OR PROFITS,
** WHETHER IN AN ACTION OF CONTRACT, NEGLIGENCE OR OTHER TORTIOUS ACTION,
** ARISING OUT OF OR IN CONNECTION WITH THE USE OR PERFORMANCE OF THIS
** SOFTWARE.
*/

#include "emu.h"
#include "config.h"

using namespace std;

string get_ext(const string& s)
{
    string ext;
    auto i = s.find_last_of(".");
    if (i > 0) {
        ext = s.substr(i+1);
        for (i = 0; i < ext.length(); i++)
            ext[i] = tolower(ext[i]);
    }
    return ext;
}

// missing in arduino?
string to_string(int i)
{
    char buf[32];
    sprintf(buf, "%d", i);
    return std::string(buf);
}

static std::map<std::string,std::string> _prefs;
std::string get_pref(const std::string& key) {
    auto it = _prefs.find(key);
    return it == _prefs.end() ? std::string() : it->second;
}
void set_pref(const std::string& key, const std::string& value) {
    _prefs[key] = value;
}

const uint8_t _font[2048] = {
    // atari 256 char inverted set
    0x00,0x18,0x03,0x18,0x18,0x00,0x03,0xc0,
    0x01,0x00,0x80,0x0f,0xf0,0xff,0x00,0x00,
    0x24,0x28,0x08,0x10,0x10,0x10,0x08,0x08,
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    0xff,0x87,0xff,0xff,0xe7,0xff,0xff,0xff,
};

const char* _menu[] = {
    "Files",
    "Info",
    "Help",
    NULL
};

class Overlay {
public:
    uint8_t* _buf;
    uint32_t _blit[16];

    uint8_t** _lines;
    int _width;
    int _height;
    int _hilite;
    int _flavor;
    int OVERLAY_WIDTH;
    int OVERLAY_HEIGHT;

    Overlay() : _hilite(0),_buf(0)
    {
    }

    void set_colors(uint8_t fg, uint8_t bg)
    {
        for (int i = 0; i < 16; i++) {
            uint32_t m = 0;
            for (int j = 0; j < 4; j++) {
                m <<= 8;
                if ((1 << j) & i)
                    m |= fg;
                else
                    m |= bg;
            }
            _blit[i] = m;
        }
    }

    void init(uint8_t** lines, int width, int height, int flavor)
    {
        _lines = lines;
        _width = width;
        _height = height;
        _flavor = flavor;
        // Only NES overlay style is supported
        OVERLAY_WIDTH = 28;
        OVERLAY_HEIGHT = 20;
        set_colors(0x39,0x09);

        _buf = new uint8_t[OVERLAY_WIDTH*OVERLAY_HEIGHT];
        memset(_buf,0,OVERLAY_WIDTH*OVERLAY_HEIGHT);
    }

    void set_lines(uint8_t** lines)
    {
        _lines = lines;
    }

    void set_hilite(int c)
    {
        _hilite = c;
    }

    void draw_char(int c, int x, int y)
    {
        x *= 8;
        y *= 8;
        const uint8_t* src = _font + c;
        for (int line = 0; line < 8; line++) {
            uint32_t* dst = (uint32_t*)(x + _lines[y++]);
            uint8_t b = src[0];
            dst[0] = _blit[b >> 4]; // long words
            dst[1] = _blit[b & 0xF];
            src += 256;
        }
    }

    // draw a note at bottom of screen
    void draw_msg(const string& msg)
    {
        if (!_lines)
            return;
        int n = (int)msg.size();
        for (int i = 0; i < n; i++) {
            int x = i - n/2 + _width/16;
            if (x >= _width)
                break;
            if (x >= 0)
                draw_char(msg[i],x,_height/8-2);
        }
    }

    void erase_msg()
    {
        if (!_lines)
            return;
        for (int i = _height-16; i < _height-8; i++)
        {
            uint32_t* d = (uint32_t*)_lines[i];
            int n = _width/4;
            while (n--)
                *d++ = 0;
        }
    }


    // 32 bit aligned access
    inline uint8_t getp(const uint8_t* src)
    {
        size_t s = (size_t)src;
        return *((uint32_t*)(s & ~3)) >> ((s & 3) << 3);
    }

    inline void setp(uint8_t* dst, uint8_t p)
    {
        size_t s = (size_t)dst;
        size_t shift = (s & 3) << 3;
        uint32_t* d = (uint32_t*)(s & ~3);
        d[0] = (d[0] & ~(0xFF << shift)) | (p << shift);
    }

    inline void luma(uint8_t* dst, int c)
    {
        uint8_t p = getp(dst);
        uint8_t r,g,b;
        // NES luma adjust only
        b = (((p >> 4) & 3) * c) >> 7;
        if (b > 3) b = 3;
        p = (b << 4) | (p & 0xCF);
        setp(dst,p);
    }

    void hline(int c, int x0, int x1, int y)
    {
        uint8_t* dst = _lines[y] + x0;
        if (c < 0) {
            for (int x = x0; x < x1; x++)
                 luma(dst++,-c);
        } else {
            for (int x = x0; x < x1; x++)
                 setp(dst++,c);
        }
    }

    void vline(int c, int x, int y0, int y1)
    {
        if (c < 0) {
            for (int y = y0; y < y1; y++)
                 luma(_lines[y] + x,-c);
        } else {
            for (int y = y0; y < y1; y++)
                 setp(_lines[y] + x,c);
        }
    }

    void frame()
    {
        int left = (_width-OVERLAY_WIDTH*8)/2;    // in pixels
        int top = (_height-OVERLAY_HEIGHT*8)/2;
        int bottom = top + OVERLAY_HEIGHT*8;
        int right = left + OVERLAY_WIDTH*8;

        for (int i = 0; i < 4; i++) {
            int c = -(i*32 + 16);
            hline(c,left+i-1,right+i+1,bottom+i);
            vline(c,right+i,top+i,bottom+i);
        }
        hline(-32,left-1,right+1,top-1);
        vline(-32,left-1,top-1,bottom+1);
    }

    void update()
    {
        if (!_lines)
            return;
        uint8_t* s = _buf;
        int xx = (_width-OVERLAY_WIDTH*8) >> 4;
        int yy = (_height-OVERLAY_HEIGHT*8) >> 4;
        for (int y = 0; y < OVERLAY_HEIGHT; y++) {
            for (int x = 0; x < OVERLAY_WIDTH; x++) {
                draw_char(*s++,x+xx,y+yy);
            }
        }
    }

    void plot_char(int c, int x, int y)
    {
        if (x < 0 || x >= OVERLAY_WIDTH)   //
            return;
        if (y < 0 || y >= OVERLAY_HEIGHT)
            return;
        _buf[x + y*OVERLAY_WIDTH] = c + (_hilite << 7);
    }

    void plot_str(const char* t, int x, int y)
    {
        int len = (int)strlen(t);
        for (int i = 0; i < len; i++)
            plot_char((uint8_t)*t++,x++,y);
    }

    void fill(int y, int x0, int x1, int c)
    {
        for (int x = x0; x < x1; x++)
            plot_char(c,x,y);
    }
};

string get_ext(const string& s);

class GUI {
public:

    string _path;
    vector<string> _files;
    vector<string> _info;
    int _tab_hilited[3];
    int _tab_scroll[3];
    int _active;
    int _hilited;
    int _scroll;
    int _tab;
    int _visible;
    bool _dirty;
    int _click;
    Emu* _emu;
    Overlay* _overlay;

    string _msg;
    uint32_t _msg_ticks;

    GUI() : _active(0),_hilited(0),_tab(0),_visible(0),_dirty(true),_click(0),_emu(0)
    {
        _tab_hilited[0] = _tab_hilited[1] = _tab_hilited[2] = 0;
        _tab_scroll[0] = _tab_scroll[1] = _tab_scroll[2] = 0;
    }

    void msg(const char* m)
    {
        _msg = m;
        _msg_ticks = 120;
    }

    int want(const char* ext)
    {
        auto exts = _emu->_ext;
        for (int i = 0; exts[i]; i++)
            if (strcmp(ext,exts[i]) == 0)
                return i;
        return -1;
    }

    // map to sort
    void read_directory(const char* name)
    {
        _files.clear();
        std::map<string,int> files;  // sort by name
        // Try the provided path first
        printf("[GUI] read_directory: trying '%s'\n", name);
        const char* path = name;
        DIR* dirp = opendir(path);
        if (!dirp) {
            // Fallback to "/spiffs" prefixed path if root mount differs
            static char alt[256];
            snprintf(alt,sizeof(alt),"/spiffs%s", name);
            printf("[GUI] read_directory: trying fallback '%s'\n", alt);
            dirp = opendir(alt);
            if (dirp)
                path = alt;
        }
        if (!dirp) {
            _path = name;
            printf("[GUI] read_directory: failed opening '%s' and '/spiffs%s'\n", name, name);
            return;             // no folder yet
        }
        _path = path;
        printf("[GUI] read_directory: scanning '%s'\n", _path.c_str());
        struct dirent * dp;
        while ((dp = readdir(dirp)) != NULL) {
            if (dp->d_type == DT_DIR) {
                // directory
            } else {
                string ext = get_ext(dp->d_name);
                int e = want(ext.c_str());
                if (e != -1)
                    files[dp->d_name] = e;
            }
        }
        for (auto& p : files)
            _files.push_back(p.first);
        closedir(dirp);
        printf("[GUI] read_directory: found %d file(s) in '%s'\n", (int)_files.size(), _path.c_str());
    }

    void draw_menu(int x, const char* name, bool selected)
    {
        _overlay->set_hilite(selected);
        _overlay->plot_str(" ",x++,0);
        _overlay->plot_str(name,x,0);
        x += strlen(name);
        _overlay->plot_str(" ",x++,0);
        _overlay->set_hilite(0);
    }

    void move_tab(int dir)
    {
        dir += _tab;
        if (dir < 0 || dir > 2)
            return;
        _tab_scroll[_tab] = _scroll;
        _tab_hilited[_tab] = _hilited;
        _tab = dir;
        _scroll = _tab_scroll[_tab] ;
        _hilited = _tab_hilited[_tab];
        _dirty = true;
    }

    void move_v(int dir)
    {
        int c = count();
        _hilited += dir;
        if (_tab != 0) {
            int h = _overlay->OVERLAY_HEIGHT;
            _hilited = dir == -1 ? _scroll-1 : _scroll+(h-2);   //
        }
        _hilited = max(0,min(_hilited,c-1));
    }
    
    int count()
    {
        switch (_tab) {
            case 0: return (int)_files.size();
            case 1: return (int)_info.size();
            case 2: {
                const char** s = _emu->_help;
                int i = 0;
                while (s[i++])
                    ;
                return i;
            }
        }
        return 0;
    }

    // Disk management removed (Atari-only)

    void insert(const string& path, int flags)
    {
        set_pref("recent",path);
        _emu->insert(_path + "/" + path,flags);
    }

    // insert_disk removed (Atari-only)

    void enter(int mods)
    {
        if (_tab != 0)
            return;

        int flags = 1;
        if (mods & 2)
            flags |= 2; // shift key
        insert(_files[_hilited],flags);
        _visible = false;
    }

    // is_disk removed

    // disk_name removed

    int find_file(const string& file)
    {
        for (auto i = 0; i < _files.size(); i++) {
            if (_files[i] == file)
                return i;
        }
        return -1;
    }

    // find_disk removed

    // disk_key removed

    // raw keycode
    bool key(int keycode, int pressed, int mods)
    {
        #ifndef GUI_DEBUG
        #define GUI_DEBUG 0
        #endif
        #if GUI_DEBUG
        printf("key:%02X %02X %02X\n",keycode,pressed,mods);
        #endif
        if (pressed && _visible)
            _click = 1;

                if (pressed && keycode == 58) { // F1 - GUI key
            _visible = !_visible;       // toggle GUI
            if (_visible)
                _overlay->frame();      // draw the frame when it first appears
            _click = 1;
            return true;
        }
        if (!_visible)
            return false;

        if (pressed) {
            switch (keycode) {
                case 40:
                    enter(mods);    // return
                    break;
                case KEYCODE_REFRESH:
                    if (!_path.empty()) {
                        read_directory(_path.c_str());
                        if (_hilited >= (int)_files.size())
                            _hilited = _files.empty() ? 0 : (int)_files.size()-1;
                        _scroll = 0;
                        _dirty = true;
                        _click = 1;
                    }
                    break;
                case 82:    // up
                    move_v(-1);
                    break;
                case 81:    // down
                    move_v(1);
                    break;
                case 80:    // left
                    move_tab(-1);
                    break;
                case 79:    // right
                    move_tab(1);
                    break;
                case 224:   // left control key
                    break;  // FIRE
            }
        }
        return true;
    }

    void insert_default(const char* path)
    {
        // Try multiple known locations, old and new
        const char* candidates[] = {
            path,                 // caller-provided
            "/NesRoms",          // new default
            "/nofrendo",         // legacy default
            "/spiffs/NesRoms",   // SPIFFS-mounted variant
            "/spiffs/nofrendo",  // SPIFFS-mounted legacy
            nullptr
        };

        for (int i = 0; candidates[i]; i++) {
            read_directory(candidates[i]);
            if (!_files.empty())
                break;
        }

        int recent = find_file(get_pref("recent"));
        _hilited = (_files.empty() ? 0 : (recent == -1 ? 0 : recent));
        _visible = true;
    }

    void update_video()
    {
        if (_visible) {
            extern uint8_t** _lines;
            _overlay->set_lines(_lines);
            for (int y = 0; y < _overlay->OVERLAY_HEIGHT; y++)
                for (int x = 0; x < _overlay->OVERLAY_WIDTH; x++)
                    _overlay->plot_char(' ',x,y);
            _overlay->set_hilite(true);
            _overlay->plot_str(" NES ROMs ", 1, 0);
            _overlay->set_hilite(false);
            if (_files.empty() && !_path.empty()) read_directory(_path.c_str());
            if (_files.empty()) {
                _overlay->plot_str("No ROMs found!", 1, 2);
                _overlay->plot_str("Put .nes files in data/NesRoms", 1, 3);
                _overlay->plot_str("and build/restart.", 1, 4);
            } else {
                int max_rows = _overlay->OVERLAY_HEIGHT - 2;
                int start = _scroll;
                int end = start + max_rows;
                if (end > (int)_files.size()) end = (int)_files.size();
                for (int i = start, row = 1; i < end; i++, row++) {
                    bool sel = (i == _hilited);
                    _overlay->set_hilite(sel);
                    std::string name = _files[i];
                    if ((int)name.size() > (_overlay->OVERLAY_WIDTH-2))
                        name.resize(_overlay->OVERLAY_WIDTH-2);
                    _overlay->plot_str(name.c_str(), 1, row);
                }
                _overlay->set_hilite(false);
            }
            _overlay->update();
        } else {
            _emu->update();
        }
    }

    void update_audio()
    {
        int16_t abuffer[313*2];
        int format = _emu->audio_format >> 8;
        int sample_count = _emu->frame_sample_count();
        if (_visible) {
            format = 1;
            if (_click) {
                _click = 0;
                static const uint16_t _wav[16] = {
                    0x0000,0x187D,0x2D41,0x3B20,0x3FFF,0x3B20,0x2D41,0x187D,
                    0x0000,0xE783,0xD2BF,0xC4E0,0xC001,0xC4E0,0xD2BF,0xE783
                };
                for (int i = 0; i < sample_count; i++)
                    abuffer[i] = _wav[i&0xF];
            } else {
                memset(abuffer,0,sizeof(abuffer));
            }
        } else {
            sample_count = _emu->audio_buffer(abuffer,sizeof(abuffer));
        }
        audio_write_16(abuffer,sample_count,format);
    }

};

Overlay _overlay;
GUI _gui;
void gui_start(Emu* emu, const char* path)
{
    _gui._emu = emu;
    _gui._overlay = &_overlay;
    _gui.insert_default(path);
    _overlay.init(emu->video_buffer(),emu->width,emu->height,emu->flavor);
}

void gui_update()
{
    _gui.update_audio();
    _gui.update_video();

    // HID/IR input removed in favor of Bluepad32
}

void gui_key(int keycode, int pressed, int mods)
{
    if (!_gui.key(keycode,pressed,mods))
        _gui._emu->key(keycode,pressed,mods);
}

// Expose GUI visibility so input adapters can adjust mappings
bool gui_is_visible()
{
    return _gui._visible;
}
